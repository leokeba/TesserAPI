## examples/idf/http_api/main/Kconfig.projbuild
```kconfig
menu "Example Configuration"

config EXAMPLE_LED_GPIO
    int "LED GPIO"
    default 2
    help
        The pin of the LED the API drives with PWM. GPIO 2 is the onboard
        LED of most ESP32 devkits.

endmenu
```

## test/hardware/sdkconfig.defaults
```kconfig
CONFIG_ESP_MAIN_TASK_STACK_SIZE=8192
CONFIG_HTTPD_MAX_REQ_HDR_LEN=1024
CONFIG_ESP_WIFI_STATIC_RX_BUFFER_NUM=6
CONFIG_ESPTOOLPY_FLASHSIZE_4MB=y
CONFIG_PARTITION_TABLE_SINGLE_APP_LARGE=y
```
